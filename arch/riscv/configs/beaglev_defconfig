## drivers/cpuidle/Kconfig.riscv
```kconfig
# SPDX-License-Identifier: GPL-2.0-only
#
# RISCV CPU Idle Drivers
#
config LIGHT_CPUIDLE
	bool "Cpuidle driver for Thead light platforms"
	depends on CPU_IDLE
	depends on SOC_THEAD
	default y
	help
	  Select this option to enable processor idle state management
	  through cpuidle subsystem.

config RISCV_SBI_CPUIDLE
	bool "RISC-V SBI CPU idle Driver"
	depends on RISCV_SBI
	select DT_IDLE_STATES
	select CPU_IDLE_MULTIPLE_DRIVERS
	select DT_IDLE_GENPD if PM_GENERIC_DOMAINS_OF
	help
	  Select this option to enable RISC-V SBI firmware based CPU idle
	  driver for RISC-V systems. This drivers also supports hierarchical
	  DT based layout of the idle state.
```

## drivers/nna/Kconfig
```kconfig
menuconfig VHA
       tristate "IMG neural network accelerator"
       default m

if VHA
choice 
      prompt "VHA platform"
      config VHA_THEAD_LIGHT_FPGA_C910
             bool "driver runs with T-Head Light-FPGA hw platform using a device tree."
             select HW_AX3
      config VHA_DUMMY
             bool "driver runs without hardware."
endchoice
config TARGET_OSID
      int
      default 0
config HW_AX3
      bool "driver runs AX31xx/AX33xx/AX35xx hardware."
      select VHA_MMU_MIRRORED_CTX
      select VHA_SYS_AURA
config VHA_MMU_MIRRORED_CTX
      bool "driver is compiled with mirrored MMU page tables regarding MODEL & IO."
      depends on HW_AX3
config VHA_SYS_AURA
      bool "driver runs with Aura system configuration file."
      depends on HW_AX3
endif
```
