/* SPDX-License-Identifier: GPL-2.0 */
/*
 * Copyright (C) 2021 Alibaba Group Holding Limited.
 */

/dts-v1/;

/* #include "fire-emu.dts" */
#include "fire-emu-soc-base.dts"

&light_iopmp {
        status = "disabled";
};
