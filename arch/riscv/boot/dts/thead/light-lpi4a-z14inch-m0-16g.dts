/* SPDX-License-Identifier: GPL-2.0 */
/*
 * Copyright (C) 2022 Alibaba Group Holding Limited.
 */

#include "light-lpi4a-z14inch-m0.dts"

/ {
	memory@0 {
		device_type = "memory";
		reg = <0x0 0x200000 0x3 0xffe00000>;
	};
};

&cmamem {
	alloc-ranges = <0x3 0xe4000000 0 0x14000000>; // [0x3E400_0000 ~ 0x3F800_0000]
};
